## boards/others/schneggi_sensor/Kconfig.schneggi_sensor
```kconfig
# SPDX-License-Identifier: Apache-2.0

config BOARD_SCHNEGGI_SENSOR
	select SOC_NRF52840_QIAA
```

## boards/others/schneggi_sensor/board.yml
```yaml
board:
  name: schneggi_sensor
  full_name: Schneggi Sensor (nRF52840)
  vendor: others
  socs:
    - name: nrf52840
```
