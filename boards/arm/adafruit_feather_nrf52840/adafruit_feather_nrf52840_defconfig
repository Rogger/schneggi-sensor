## boards/arm/adafruit_feather_nrf52840/adafruit_feather_nrf52840_defconfig
```kconfig
# SPDX-License-Identifier: Apache-2.0


# Enable MPU
CONFIG_ARM_MPU=y

# enable GPIO
CONFIG_GPIO=y

CONFIG_PINCTRL=y
```
